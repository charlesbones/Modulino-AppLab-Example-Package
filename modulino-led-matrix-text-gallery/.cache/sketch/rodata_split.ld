/* Auto-generated linker script fragment for LLEXT
 * Separates .rodata sections based on relocation status
 */

SECTIONS
{
    /* Read-only data WITH relocations - will be copied to RAM by LLEXT */
    .rodata : {
        *(.rodata.Font_5x7)
        *(.rodata._ZN6zephyr7arduinoL11pinctrl_mapE)
        *(.rodata._ZN6zephyr7arduinoL35__pinctrl_states__device_dts_ord_17E)
        *(.rodata._ZN6zephyr7arduinoL35__pinctrl_states__device_dts_ord_25E)
        *(.rodata._ZN6zephyr7arduinoL35__pinctrl_states__device_dts_ord_29E)
        *(.rodata._ZN6zephyr7arduinoL35__pinctrl_states__device_dts_ord_35E)
        *(.rodata._ZN6zephyr7arduinoL35__pinctrl_states__device_dts_ord_55E)
        *(.rodata._ZN6zephyr7arduinoL35__pinctrl_states__device_dts_ord_64E)
        *(.rodata._ZN6zephyr7arduinoL35__pinctrl_states__device_dts_ord_67E)
        *(.rodata._ZN6zephyr7arduinoL35__pinctrl_states__device_dts_ord_72E)
        *(.rodata._ZN6zephyr7arduinoL35__pinctrl_states__device_dts_ord_80E)
        *(.rodata._ZN6zephyr7arduinoL35__pinctrl_states__device_dts_ord_85E)
        *(.rodata._ZN6zephyr7arduinoL35__pinctrl_states__device_dts_ord_97E)
        *(.rodata._ZN6zephyr7arduinoL36__pinctrl_states__device_dts_ord_102E)
        *(.rodata._ZN6zephyr7arduinoL36__pinctrl_states__device_dts_ord_106E)
        *(.rodata._ZN6zephyr7arduinoL36__pinctrl_states__device_dts_ord_111E)
        *(.rodata._ZN6zephyr7arduinoL36__pinctrl_states__device_dts_ord_117E)
        *(.rodata._ZN6zephyr7arduinoL36__pinctrl_states__device_dts_ord_120E)
        *(.rodata._ZN6zephyr7arduinoL39__pinctrl_dev_config__device_dts_ord_17E)
        *(.rodata._ZN6zephyr7arduinoL39__pinctrl_dev_config__device_dts_ord_25E)
        *(.rodata._ZN6zephyr7arduinoL39__pinctrl_dev_config__device_dts_ord_29E)
        *(.rodata._ZN6zephyr7arduinoL39__pinctrl_dev_config__device_dts_ord_35E)
        *(.rodata._ZN6zephyr7arduinoL39__pinctrl_dev_config__device_dts_ord_55E)
        *(.rodata._ZN6zephyr7arduinoL39__pinctrl_dev_config__device_dts_ord_64E)
        *(.rodata._ZN6zephyr7arduinoL39__pinctrl_dev_config__device_dts_ord_67E)
        *(.rodata._ZN6zephyr7arduinoL39__pinctrl_dev_config__device_dts_ord_72E)
        *(.rodata._ZN6zephyr7arduinoL39__pinctrl_dev_config__device_dts_ord_80E)
        *(.rodata._ZN6zephyr7arduinoL39__pinctrl_dev_config__device_dts_ord_85E)
        *(.rodata._ZN6zephyr7arduinoL39__pinctrl_dev_config__device_dts_ord_97E)
        *(.rodata._ZN6zephyr7arduinoL40__pinctrl_dev_config__device_dts_ord_102E)
        *(.rodata._ZN6zephyr7arduinoL40__pinctrl_dev_config__device_dts_ord_106E)
        *(.rodata._ZN6zephyr7arduinoL40__pinctrl_dev_config__device_dts_ord_111E)
        *(.rodata._ZN6zephyr7arduinoL40__pinctrl_dev_config__device_dts_ord_117E)
        *(.rodata._ZN6zephyr7arduinoL40__pinctrl_dev_config__device_dts_ord_120E)
        *(.rodata._ZTV13BridgeMonitorILj512EE)
        *(.rodata._ZTV15ArduinoGraphics)
        *(.rodata._ZTV15SerialTransport)
        *(.rodata._ZTV17ModulinoLEDMatrix)
        *(.rodata._ZTV18RpcFunctionWrapperISt8functionIFN7arduino6StringEiEEE)
        *(.rodata._ZTV18RpcFunctionWrapperISt8functionIFN7arduino6StringEiiiEEE)
        *(.rodata._ZTV18RpcFunctionWrapperISt8functionIFN7arduino6StringEvEEE)
        *(.rodata._ZTVN7arduino12ZephyrSerialE)
        *(.rodata._ZTVN7arduino9ZephyrI2CE)
        *(.rodata._ZTVN7arduino9ZephyrSPIE)
    }

    /* Read-only data WITHOUT relocations - kept in flash by LLEXT */
    .llext.rodata.noreloc : {
        *(.rodata._Z10buildStatev.str1.1)
        *(.rodata._ZL13LEDMATRIX_UNO)
        *(.rodata._ZL14LEDMATRIX_CHIP)
        *(.rodata._ZL14LEDMATRIX_LIKE)
        *(.rodata._ZL16LEDMATRIX_DANGER)
        *(.rodata._ZL18LEDMATRIX_RESISTOR)
        *(.rodata._ZL19LEDMATRIX_BLUETOOTH)
        *(.rodata._ZL19LEDMATRIX_EMOJI_SAD)
        *(.rodata._ZL19LEDMATRIX_HEART_BIG)
        *(.rodata._ZL20GRAYSCALE_IDENTIFIER)
        *(.rodata._ZL20LEDMATRIX_CLOUD_WIFI)
        *(.rodata._ZL20LEDMATRIX_MUSIC_NOTE)
        *(.rodata._ZL21LEDMATRIX_EMOJI_BASIC)
        *(.rodata._ZL21LEDMATRIX_EMOJI_HAPPY)
        *(.rodata._ZL21LEDMATRIX_HEART_SMALL)
        *(.rodata._ZL23LEDMATRIX_ANIMATION_BUG)
        *(.rodata._ZL23LEDMATRIX_ANIMATION_DVD)
        *(.rodata._ZL23LEDMATRIX_BOOTLOADER_ON)
        *(.rodata._ZL24LEDMATRIX_ANIMATION_LOAD)
        *(.rodata._ZL24LEDMATRIX_ANIMATION_LOCK)
        *(.rodata._ZL24MONOCHROMATIC_IDENTIFIER)
        *(.rodata._ZL25LEDMATRIX_ANIMATION_CHECK)
        *(.rodata._ZL25LEDMATRIX_ANIMATION_CLOUD)
        *(.rodata._ZL26LEDMATRIX_ANIMATION_ATMEGA)
        *(.rodata._ZL26LEDMATRIX_ANIMATION_TETRIS)
        *(.rodata._ZL27LEDMATRIX_ANIMATION_BATTERY)
        *(.rodata._ZL27LEDMATRIX_ANIMATION_STARTUP)
        *(.rodata._ZL28LEDMATRIX_ANIMATION_DOWNLOAD)
        *(.rodata._ZL29LEDMATRIX_ANIMATION_HEARTBEAT)
        *(.rodata._ZL29LEDMATRIX_ANIMATION_HOURGLASS)
        *(.rodata._ZL30LEDMATRIX_ANIMATION_LOAD_CLOCK)
        *(.rodata._ZL30LEDMATRIX_ANIMATION_OPENSOURCE)
        *(.rodata._ZL31LEDMATRIX_ANIMATION_WIFI_SEARCH)
        *(.rodata._ZL32LEDMATRIX_ANIMATION_NOTIFICATION)
        *(.rodata._ZL32LEDMATRIX_ANIMATION_TETRIS_INTRO)
        *(.rodata._ZL33LEDMATRIX_ANIMATION_BOUNCING_BALL)
        *(.rodata._ZL33LEDMATRIX_ANIMATION_SPINNING_COIN)
        *(.rodata._ZL34LEDMATRIX_ANIMATION_ARROWS_COMPASS)
        *(.rodata._ZL34LEDMATRIX_ANIMATION_AUDIO_WAVEFORM)
        *(.rodata._ZL34LEDMATRIX_ANIMATION_HEARTBEAT_LINE)
        *(.rodata._ZL38LEDMATRIX_ANIMATION_LED_BLINK_VERTICAL)
        *(.rodata._ZL40LEDMATRIX_ANIMATION_INFINITY_LOOP_LOADER)
        *(.rodata._ZL40LEDMATRIX_ANIMATION_LED_BLINK_HORIZONTAL)
        *(.rodata._ZN10RpcDecoderILj1024EE12get_responseIN7arduino7msgpack6object5nil_tEEEbjRT_R8RpcError.str1.1)
        *(.rodata._ZN10RpcDecoderILj1024EE12get_responseIbEEbjRT_R8RpcError.str1.1)
        *(.rodata._ZN11BridgeClass11update_safeEv.str1.1)
        *(.rodata._ZN11BridgeClass7provideIRFN7arduino6StringEvEEEbRKS2_OT_.isra.0.str1.1)
        *(.rodata._ZN13BridgeMonitorILj512EE5_readEj.str1.1)
        *(.rodata._ZN13BridgeMonitorILj512EE5writeEPKhj.str1.1)
        *(.rodata._ZN13BridgeMonitorILj512EEcvbEv.str1.1)
        *(.rodata._ZN15ArduinoGraphics5flushEv.str1.1)
        *(.rodata._ZN18RpcFunctionWrapperISt8functionIFN7arduino6StringEiEEEclERNS1_7msgpack8UnpackerERNS6_6PackerE.str1.1)
        *(.rodata._ZN18RpcFunctionWrapperISt8functionIFN7arduino6StringEvEEEclERNS1_7msgpack8UnpackerERNS6_6PackerE.str1.1)
        *(.rodata._ZN6zephyr7arduinoL41__pinctrl_state_pins_0__device_dts_ord_17E)
        *(.rodata._ZN6zephyr7arduinoL41__pinctrl_state_pins_0__device_dts_ord_25E)
        *(.rodata._ZN6zephyr7arduinoL41__pinctrl_state_pins_0__device_dts_ord_29E)
        *(.rodata._ZN6zephyr7arduinoL41__pinctrl_state_pins_0__device_dts_ord_35E)
        *(.rodata._ZN6zephyr7arduinoL41__pinctrl_state_pins_0__device_dts_ord_55E)
        *(.rodata._ZN6zephyr7arduinoL41__pinctrl_state_pins_0__device_dts_ord_64E)
        *(.rodata._ZN6zephyr7arduinoL41__pinctrl_state_pins_0__device_dts_ord_67E)
        *(.rodata._ZN6zephyr7arduinoL41__pinctrl_state_pins_0__device_dts_ord_72E)
        *(.rodata._ZN6zephyr7arduinoL41__pinctrl_state_pins_0__device_dts_ord_80E)
        *(.rodata._ZN6zephyr7arduinoL41__pinctrl_state_pins_0__device_dts_ord_85E)
        *(.rodata._ZN6zephyr7arduinoL41__pinctrl_state_pins_0__device_dts_ord_97E)
        *(.rodata._ZN6zephyr7arduinoL41__pinctrl_state_pins_1__device_dts_ord_17E)
        *(.rodata._ZN6zephyr7arduinoL41__pinctrl_state_pins_1__device_dts_ord_35E)
        *(.rodata._ZN6zephyr7arduinoL41__pinctrl_state_pins_1__device_dts_ord_80E)
        *(.rodata._ZN6zephyr7arduinoL41__pinctrl_state_pins_1__device_dts_ord_97E)
        *(.rodata._ZN6zephyr7arduinoL41__pinctrl_state_pins_2__device_dts_ord_17E)
        *(.rodata._ZN6zephyr7arduinoL41__pinctrl_state_pins_2__device_dts_ord_97E)
        *(.rodata._ZN6zephyr7arduinoL42__pinctrl_state_pins_0__device_dts_ord_102E)
        *(.rodata._ZN6zephyr7arduinoL42__pinctrl_state_pins_0__device_dts_ord_106E)
        *(.rodata._ZN6zephyr7arduinoL42__pinctrl_state_pins_0__device_dts_ord_111E)
        *(.rodata._ZN6zephyr7arduinoL42__pinctrl_state_pins_0__device_dts_ord_117E)
        *(.rodata._ZN6zephyr7arduinoL42__pinctrl_state_pins_0__device_dts_ord_120E)
        *(.rodata._ZN6zephyr7arduinoL42__pinctrl_state_pins_1__device_dts_ord_102E)
        *(.rodata._ZN6zephyr7arduinoL42__pinctrl_state_pins_1__device_dts_ord_106E)
        *(.rodata._ZN6zephyr7arduinoL42__pinctrl_state_pins_1__device_dts_ord_111E)
        *(.rodata._ZN6zephyr7arduinoL42__pinctrl_state_pins_1__device_dts_ord_117E)
        *(.rodata._ZN6zephyr7arduinoL42__pinctrl_state_pins_1__device_dts_ord_120E)
        *(.rodata._ZN6zephyr7arduinoL42__pinctrl_state_pins_2__device_dts_ord_102E)
        *(.rodata._ZN6zephyr7arduinoL42__pinctrl_state_pins_2__device_dts_ord_106E)
        *(.rodata._ZN6zephyr7arduinoL42__pinctrl_state_pins_2__device_dts_ord_111E)
        *(.rodata._ZN6zephyr7arduinoL42__pinctrl_state_pins_2__device_dts_ord_117E)
        *(.rodata._ZN6zephyr7arduinoL42__pinctrl_state_pins_2__device_dts_ord_120E)
        *(.rodata._ZN7RpcCallIJEE6resultIbEEbRT_.str1.1)
        *(.rodata._ZN7RpcCallIJRKN7arduino6StringEEEC2ES3_P9RPCClientP7k_mutexS8_S3_.str1.1)
        *(.rodata._ZN7arduino7msgpack6object3extC2EaPKhj.str1.1)
        *(.rodata._ZN8RpcErrorC2Ev.str1.1)
        *(.rodata._ZNSt6vectorIjSaIjEE17_M_realloc_insertIJRjEEEvN9__gnu_cxx17__normal_iteratorIPjS1_EEDpOT_.str1.1)
        *(.rodata.__compound_literal.0)
        *(.rodata.__compound_literal.1)
        *(.rodata.__compound_literal.10)
        *(.rodata.__compound_literal.100)
        *(.rodata.__compound_literal.101)
        *(.rodata.__compound_literal.102)
        *(.rodata.__compound_literal.103)
        *(.rodata.__compound_literal.104)
        *(.rodata.__compound_literal.105)
        *(.rodata.__compound_literal.106)
        *(.rodata.__compound_literal.107)
        *(.rodata.__compound_literal.108)
        *(.rodata.__compound_literal.109)
        *(.rodata.__compound_literal.11)
        *(.rodata.__compound_literal.110)
        *(.rodata.__compound_literal.111)
        *(.rodata.__compound_literal.112)
        *(.rodata.__compound_literal.113)
        *(.rodata.__compound_literal.114)
        *(.rodata.__compound_literal.115)
        *(.rodata.__compound_literal.116)
        *(.rodata.__compound_literal.117)
        *(.rodata.__compound_literal.118)
        *(.rodata.__compound_literal.119)
        *(.rodata.__compound_literal.12)
        *(.rodata.__compound_literal.120)
        *(.rodata.__compound_literal.121)
        *(.rodata.__compound_literal.122)
        *(.rodata.__compound_literal.123)
        *(.rodata.__compound_literal.124)
        *(.rodata.__compound_literal.125)
        *(.rodata.__compound_literal.126)
        *(.rodata.__compound_literal.127)
        *(.rodata.__compound_literal.128)
        *(.rodata.__compound_literal.129)
        *(.rodata.__compound_literal.13)
        *(.rodata.__compound_literal.130)
        *(.rodata.__compound_literal.131)
        *(.rodata.__compound_literal.132)
        *(.rodata.__compound_literal.133)
        *(.rodata.__compound_literal.134)
        *(.rodata.__compound_literal.135)
        *(.rodata.__compound_literal.136)
        *(.rodata.__compound_literal.137)
        *(.rodata.__compound_literal.138)
        *(.rodata.__compound_literal.139)
        *(.rodata.__compound_literal.14)
        *(.rodata.__compound_literal.140)
        *(.rodata.__compound_literal.141)
        *(.rodata.__compound_literal.142)
        *(.rodata.__compound_literal.143)
        *(.rodata.__compound_literal.144)
        *(.rodata.__compound_literal.145)
        *(.rodata.__compound_literal.146)
        *(.rodata.__compound_literal.147)
        *(.rodata.__compound_literal.148)
        *(.rodata.__compound_literal.149)
        *(.rodata.__compound_literal.15)
        *(.rodata.__compound_literal.150)
        *(.rodata.__compound_literal.151)
        *(.rodata.__compound_literal.152)
        *(.rodata.__compound_literal.153)
        *(.rodata.__compound_literal.154)
        *(.rodata.__compound_literal.155)
        *(.rodata.__compound_literal.156)
        *(.rodata.__compound_literal.157)
        *(.rodata.__compound_literal.158)
        *(.rodata.__compound_literal.159)
        *(.rodata.__compound_literal.16)
        *(.rodata.__compound_literal.160)
        *(.rodata.__compound_literal.161)
        *(.rodata.__compound_literal.162)
        *(.rodata.__compound_literal.163)
        *(.rodata.__compound_literal.164)
        *(.rodata.__compound_literal.165)
        *(.rodata.__compound_literal.166)
        *(.rodata.__compound_literal.167)
        *(.rodata.__compound_literal.168)
        *(.rodata.__compound_literal.169)
        *(.rodata.__compound_literal.17)
        *(.rodata.__compound_literal.170)
        *(.rodata.__compound_literal.171)
        *(.rodata.__compound_literal.172)
        *(.rodata.__compound_literal.173)
        *(.rodata.__compound_literal.174)
        *(.rodata.__compound_literal.175)
        *(.rodata.__compound_literal.176)
        *(.rodata.__compound_literal.177)
        *(.rodata.__compound_literal.178)
        *(.rodata.__compound_literal.179)
        *(.rodata.__compound_literal.18)
        *(.rodata.__compound_literal.180)
        *(.rodata.__compound_literal.181)
        *(.rodata.__compound_literal.182)
        *(.rodata.__compound_literal.183)
        *(.rodata.__compound_literal.184)
        *(.rodata.__compound_literal.185)
        *(.rodata.__compound_literal.186)
        *(.rodata.__compound_literal.187)
        *(.rodata.__compound_literal.188)
        *(.rodata.__compound_literal.189)
        *(.rodata.__compound_literal.19)
        *(.rodata.__compound_literal.190)
        *(.rodata.__compound_literal.2)
        *(.rodata.__compound_literal.20)
        *(.rodata.__compound_literal.21)
        *(.rodata.__compound_literal.22)
        *(.rodata.__compound_literal.23)
        *(.rodata.__compound_literal.24)
        *(.rodata.__compound_literal.25)
        *(.rodata.__compound_literal.26)
        *(.rodata.__compound_literal.27)
        *(.rodata.__compound_literal.28)
        *(.rodata.__compound_literal.29)
        *(.rodata.__compound_literal.3)
        *(.rodata.__compound_literal.30)
        *(.rodata.__compound_literal.31)
        *(.rodata.__compound_literal.32)
        *(.rodata.__compound_literal.33)
        *(.rodata.__compound_literal.34)
        *(.rodata.__compound_literal.35)
        *(.rodata.__compound_literal.36)
        *(.rodata.__compound_literal.37)
        *(.rodata.__compound_literal.38)
        *(.rodata.__compound_literal.39)
        *(.rodata.__compound_literal.4)
        *(.rodata.__compound_literal.40)
        *(.rodata.__compound_literal.41)
        *(.rodata.__compound_literal.42)
        *(.rodata.__compound_literal.43)
        *(.rodata.__compound_literal.44)
        *(.rodata.__compound_literal.45)
        *(.rodata.__compound_literal.46)
        *(.rodata.__compound_literal.47)
        *(.rodata.__compound_literal.48)
        *(.rodata.__compound_literal.49)
        *(.rodata.__compound_literal.5)
        *(.rodata.__compound_literal.50)
        *(.rodata.__compound_literal.51)
        *(.rodata.__compound_literal.52)
        *(.rodata.__compound_literal.53)
        *(.rodata.__compound_literal.54)
        *(.rodata.__compound_literal.55)
        *(.rodata.__compound_literal.56)
        *(.rodata.__compound_literal.57)
        *(.rodata.__compound_literal.58)
        *(.rodata.__compound_literal.59)
        *(.rodata.__compound_literal.6)
        *(.rodata.__compound_literal.60)
        *(.rodata.__compound_literal.61)
        *(.rodata.__compound_literal.62)
        *(.rodata.__compound_literal.63)
        *(.rodata.__compound_literal.64)
        *(.rodata.__compound_literal.65)
        *(.rodata.__compound_literal.66)
        *(.rodata.__compound_literal.67)
        *(.rodata.__compound_literal.68)
        *(.rodata.__compound_literal.69)
        *(.rodata.__compound_literal.7)
        *(.rodata.__compound_literal.70)
        *(.rodata.__compound_literal.71)
        *(.rodata.__compound_literal.72)
        *(.rodata.__compound_literal.73)
        *(.rodata.__compound_literal.74)
        *(.rodata.__compound_literal.75)
        *(.rodata.__compound_literal.76)
        *(.rodata.__compound_literal.77)
        *(.rodata.__compound_literal.78)
        *(.rodata.__compound_literal.79)
        *(.rodata.__compound_literal.8)
        *(.rodata.__compound_literal.80)
        *(.rodata.__compound_literal.81)
        *(.rodata.__compound_literal.82)
        *(.rodata.__compound_literal.83)
        *(.rodata.__compound_literal.84)
        *(.rodata.__compound_literal.85)
        *(.rodata.__compound_literal.86)
        *(.rodata.__compound_literal.87)
        *(.rodata.__compound_literal.88)
        *(.rodata.__compound_literal.89)
        *(.rodata.__compound_literal.9)
        *(.rodata.__compound_literal.90)
        *(.rodata.__compound_literal.91)
        *(.rodata.__compound_literal.92)
        *(.rodata.__compound_literal.93)
        *(.rodata.__compound_literal.94)
        *(.rodata.__compound_literal.95)
        *(.rodata.__compound_literal.96)
        *(.rodata.__compound_literal.97)
        *(.rodata.__compound_literal.98)
        *(.rodata.__compound_literal.99)
        *(.rodata.setup.str1.1)
        *(.rodata.str1.1)
    }

    /* Merge all .rel.rodata.* sections into .rel.rodata */
    .rel.rodata : {
        *(.rel.rodata)
        *(.rel.rodata.*)
    }

    /* Merge all .rela.rodata.* sections into .rela.rodata */
    .rela.rodata : {
        *(.rela.rodata)
        *(.rela.rodata.*)
    }

}
